
ROM_ORIGIN   = 0x00000000;
ROM_LENGTH   = 0x00040000;
STACK_ORIGIN = 0x08000000;
STACK_LENGTH = 0x00001500;
RAM_ORIGIN   = (0x08000000 + 0x00001500);
RAM_LENGTH   = (0x0003EB00 + 0x00001500);
VIM_ORIGIN   = 0xFFF82000;
VIM_LENGTH   = (0xFFF82000 + 0x000004A0);

MPU_MIN_ALIGN = 8K;

INCLUDE ../bsp.ld
