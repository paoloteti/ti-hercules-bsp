/*
 * TI TMS570LS3137 (http://www.ti.com/product/TMS570LS3137)
 *
 * Flash: 3072 (KB), RAM: 256 (KB)
 */

ROM_ORIGIN   = 0x00000020;
ROM_LENGTH   = 0x00180000;
STACK_ORIGIN = 0x08000000;
STACK_LENGTH = 0x00001500;
RAM_ORIGIN   = 0x08001500;
RAM_LENGTH   = 0x0003EB00;
VIM_ORIGIN   = 0xFFF82000;
VIM_LENGTH   = 0x000004A0;

HEAP_LENGTH  = 0x00001500;

MPU_MIN_ALIGN = 8K;

/* Stack pointers in all CPU modes */
FIQ_SP   = 0x08001200;
IRQ_SP   = 0x08001300;
SVC_SP   = 0x08001100;
ABORT_SP = 0x08001400;
UNDEF_SP = 0x08001500;
USER_SP  = 0x08001000;

INCLUDE bsp.ld
